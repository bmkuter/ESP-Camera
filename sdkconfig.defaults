## sdkconfig.defaults
```kconfig
# XIAO ESP32S3 Sense Camera Configuration

# Enable PSRAM (required for camera) - XIAO ESP32S3 Sense uses OPI (Octal) PSRAM!
CONFIG_SPIRAM=y
CONFIG_SPIRAM_MODE_OCT=y
CONFIG_SPIRAM_TYPE_AUTO=y
CONFIG_SPIRAM_SPEED_80M=y

# IMPORTANT: Disable Quad mode (XIAO uses Octal mode)
# CONFIG_SPIRAM_MODE_QUAD is not set

# Enable PSRAM features
CONFIG_SPIRAM_BOOT_INIT=y
CONFIG_SPIRAM_USE_MALLOC=y
CONFIG_SPIRAM_MALLOC_ALWAYSINTERNAL=16384

# Camera configuration - allocate frame buffers in PSRAM
CONFIG_CAMERA_CORE0=y

# Increase main task stack size for camera
CONFIG_ESP_MAIN_TASK_STACK_SIZE=8192

# mDNS Configuration
CONFIG_MDNS_MAX_SERVICES=8
CONFIG_MDNS_TASK_PRIORITY=1
CONFIG_MDNS_TASK_STACK_SIZE=4096

#
# WiFi Performance Optimization
#
CONFIG_ESP_WIFI_STATIC_RX_BUFFER_NUM=16
CONFIG_ESP_WIFI_DYNAMIC_RX_BUFFER_NUM=64
CONFIG_ESP_WIFI_DYNAMIC_TX_BUFFER_NUM=64
CONFIG_ESP_WIFI_AMPDU_TX_ENABLED=y
CONFIG_ESP_WIFI_TX_BA_WIN=32
CONFIG_ESP_WIFI_AMPDU_RX_ENABLED=y
CONFIG_ESP_WIFI_RX_BA_WIN=32

#
# TCP/IP Performance Optimization
#
# Increase TCP send buffer (critical for large image transfers)
CONFIG_LWIP_TCP_SND_BUF_DEFAULT=65535
# Increase TCP receive window
CONFIG_LWIP_TCP_WND_DEFAULT=65535
# Increase max segment size
CONFIG_LWIP_TCP_MSS=1436
# Enable TCP receive mail box size increase
CONFIG_LWIP_TCPIP_RECVMBOX_SIZE=64
# Increase default receive mail box
CONFIG_LWIP_TCP_RECVMBOX_SIZE=64
# Enable TCP oversize (better performance)
CONFIG_LWIP_TCP_OVERSIZE_MSS=y
# Disable Nagle's algorithm for lower latency
CONFIG_LWIP_TCP_NODELAY=y
# Increase TCP send queue length
CONFIG_LWIP_TCP_SND_QUEUELEN_DEFAULT=64

#
# Memory Pool Optimization
#
# Increase number of PBUF pools
CONFIG_LWIP_PBUF_POOL_SIZE=32

# Serial console configuration
CONFIG_ESPTOOLPY_BAUD_921600B=y
CONFIG_ESPTOOLPY_MONITOR_BAUD_115200B=y
```
